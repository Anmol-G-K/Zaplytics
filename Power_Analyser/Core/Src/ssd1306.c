#include "ssd1306.h"

/* ── SSD1306 command bytes ─────────────────────────────────────────── */
#define SSD1306_CMD_BYTE        0x00   /* Co=0, D/C#=0 → command stream */
#define SSD1306_DATA_BYTE       0x40   /* Co=0, D/C#=1 → data stream    */

/* ── Internal state ────────────────────────────────────────────────── */
static I2C_HandleTypeDef *_hi2c;
static volatile uint8_t   _txBusy = 0;

/*
 * Frame buffer: 1 control byte + 1024 pixel bytes
 * Laid out as 8 pages × 128 columns (each byte = 8 vertical pixels).
 * buf[0] is the I2C data-stream control byte (0x40), sent once per DMA transfer.
 */
static uint8_t _buf[1 + SSD1306_WIDTH * (SSD1306_HEIGHT / 8)];

/* Tiny 5×7 ASCII font (printable chars 0x20–0x7E) */
static const uint8_t font5x7[][5] = {
    {0x00,0x00,0x00,0x00,0x00}, /* ' ' */
    {0x00,0x00,0x5F,0x00,0x00}, /* '!' */
    {0x00,0x07,0x00,0x07,0x00}, /* '"' */
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    {0x0C,0x02,0x0C,0x10,0x0C}, /* '~' */
};

/* ── Helpers ───────────────────────────────────────────────────────── */

/* Send a command byte (interrupt mode, short transfer) */
static HAL_StatusTypeDef _sendCmd(uint8_t cmd)
{
    uint8_t buf[2] = { SSD1306_CMD_BYTE, cmd };
    /* Wait for any ongoing transfer */
    uint32_t t = HAL_GetTick();
    while (_txBusy && (HAL_GetTick() - t < 10));
    _txBusy = 1;
    return HAL_I2C_Master_Transmit_IT(_hi2c, SSD1306_I2C_ADDR, buf, 2);
}

/* Send multiple commands (blocking shortcut used only during init) */
static void _sendCmdList(const uint8_t *cmds, uint8_t len)
{
    for (uint8_t i = 0; i < len; i++) _sendCmd(cmds[i]);
    /* Allow last IT transfer to finish */
    uint32_t t = HAL_GetTick();
    while (_txBusy && (HAL_GetTick() - t < 20));
}

/* ── Public functions ──────────────────────────────────────────────── */

void SSD1306_Init(I2C_HandleTypeDef *hi2c)
{
    _hi2c = hi2c;
    _txBusy = 0;

    /* Control byte prefix for the DMA frame buffer */
    _buf[0] = SSD1306_DATA_BYTE;

    HAL_Delay(100); /* wait for display power-on */

    static const uint8_t initSeq[] = {
        0xAE,       /* display off */
        0xD5, 0x80, /* clock divide / osc freq */
        0xA8, 0x3F, /* mux ratio = 64 */
        0xD3, 0x00, /* display offset = 0 */
        0x40,       /* start line = 0 */
        0x8D, 0x14, /* charge pump ON */
        0x20, 0x00, /* horizontal addressing mode */
        0xA1,       /* seg remap (mirror X) */
        0xC8,       /* com scan dec (mirror Y) */
        0xDA, 0x12, /* com pins config */
        0x81, 0xCF, /* contrast */
        0xD9, 0xF1, /* pre-charge */
        0xDB, 0x40, /* vcomh deselect */
        0xA4,       /* entire display on (RAM content) */
        0xA6,       /* normal display (not inverted) */
        0xAF,       /* display ON */
    };
    _sendCmdList(initSeq, sizeof(initSeq));

    SSD1306_Clear();
    SSD1306_UpdateScreen();
}

void SSD1306_Clear(void)
{
    memset(&_buf[1], 0x00, SSD1306_WIDTH * (SSD1306_HEIGHT / 8));
}

void SSD1306_Fill(uint8_t pattern)
{
    memset(&_buf[1], pattern, SSD1306_WIDTH * (SSD1306_HEIGHT / 8));
}

void SSD1306_DrawPixel(uint8_t x, uint8_t y, uint8_t color)
{
    if (x >= SSD1306_WIDTH || y >= SSD1306_HEIGHT) return;
    uint16_t idx = 1 + x + (y / 8) * SSD1306_WIDTH;
    if (color)
        _buf[idx] |=  (1 << (y % 8));
    else
        _buf[idx] &= ~(1 << (y % 8));
}

void SSD1306_WriteString(uint8_t x, uint8_t page, const char *str)
{
    /* page: 0-7, x: pixel column */
    while (*str && x + 5 <= SSD1306_WIDTH) {
        uint8_t c = (uint8_t)*str++;
        if (c < 0x20 || c > 0x7E) c = '?';
        const uint8_t *glyph = font5x7[c - 0x20];
        for (uint8_t col = 0; col < 5; col++) {
            _buf[1 + x + page * SSD1306_WIDTH] = glyph[col];
            x++;
        }
        /* 1-pixel gap between characters */
        _buf[1 + x + page * SSD1306_WIDTH] = 0x00;
        x++;
    }
}

void SSD1306_UpdateScreen(void)
{
    /* Set column and page address back to (0,0) before each DMA burst */
    static const uint8_t addrReset[] = {
        0x21, 0x00, 0x7F,   /* column address: 0–127 */
        0x22, 0x00, 0x07,   /* page address:   0–7   */
    };
    _sendCmdList(addrReset, sizeof(addrReset));

    /* Kick off DMA transfer of the entire frame buffer (1025 bytes) */
    uint32_t t = HAL_GetTick();
    while (_txBusy && (HAL_GetTick() - t < 20));
    _txBusy = 1;
    HAL_I2C_Master_Transmit_DMA(_hi2c,
                                 SSD1306_I2C_ADDR,
                                 _buf,
                                 sizeof(_buf));
}

uint8_t SSD1306_IsReady(void)
{
    return !_txBusy;
}

void SSD1306_TxCpltCallback(I2C_HandleTypeDef *hi2c)
{
    if (hi2c->Instance == _hi2c->Instance)
        _txBusy = 0;
}
